/* Sketch was generated by CAGEBOT_blockly 
 Website: http://www.cagebot.com/ 
 Date: Fri Jan 26 2024 14:35:44 GMT+0800
 */ 
int  White;
int  Black;
int  Hspeed;
int  Mspeed;
int  Lspeed;
int  Dtime;
#include <moto_NeoPixel.h>
moto_NeoPixel strip13= moto_NeoPixel(2,13, NEO_GRB + NEO_KHZ800);
void colorled13(int number,String c)
{
  long rgb_number = strtol(&c[1], NULL, 16);
   int r = rgb_number >> 16;
   int g = rgb_number >> 8 & 0xFF;
   int b = rgb_number & 0xFF;
   if(number <= 0) number = 0;
      else  number--;
   strip13.setPixelColor(number,strip13.Color(r,g,b));
   strip13.show();
}

#include "motoTimerFreeTone.h"

void setup()
{
  pinMode(12, INPUT);
  pinMode(A1, INPUT);
  pinMode(A2, INPUT);
  pinMode(A3, INPUT);
  pinMode(7, OUTPUT);
  pinMode(5, OUTPUT);
  pinMode(4, OUTPUT);
  pinMode(6, OUTPUT);
  strip13.begin();
  strip13.show();
  pinMode(8, OUTPUT);
    White = 200;
  Black = 700;
  Hspeed = 80;
  Mspeed = 80;
  Lspeed = 80;
  Dtime = 5;
  while ((digitalRead(12) == 1)) {
  }

}


void loop()
{
    // 黑.白.黑
    if (analogRead(A1) > Black && analogRead(A2) < White && analogRead(A3) > Black) {
      digitalWrite(7,LOW);
      analogWrite(5,Hspeed);
      digitalWrite(4,HIGH);
      analogWrite(6,Hspeed);
      delay(Dtime);
    }
    // 白.白.黑
    if (analogRead(A1) < White && analogRead(A2) < White && analogRead(A3) > Black) {
      digitalWrite(7,HIGH);
      analogWrite(5,Lspeed);
      digitalWrite(4,HIGH);
      analogWrite(6,Lspeed);
      delay(Dtime);
    }
    // 白.黑.黑
    if (analogRead(A1) < White && analogRead(A2) > Black && analogRead(A3) > Black) {
      digitalWrite(7,LOW);
      analogWrite(5,0);
      digitalWrite(4,HIGH);
      analogWrite(6,Mspeed);
      delay(Dtime);
    }
    // 黑.黑.白
    if (analogRead(A1) > Black && analogRead(A2) > Black && analogRead(A3) < White) {
      digitalWrite(7,LOW);
      analogWrite(5,Mspeed);
      digitalWrite(4,HIGH);
      analogWrite(6,0);
      delay(Dtime);
    }
    // 黑.白.白
    if (analogRead(A1) > Black && analogRead(A2) < White && analogRead(A3) < White) {
      digitalWrite(7,LOW);
      analogWrite(5,Lspeed);
      digitalWrite(4,LOW);
      analogWrite(6,Lspeed);
      delay(Dtime);
    }
    // 白.白.白
    if (analogRead(A1) < White && analogRead(A2) < White && analogRead(A3) < White) {
      digitalWrite(7,LOW);
      analogWrite(5,Hspeed);
      digitalWrite(4,HIGH);
      analogWrite(6,Hspeed);
      colorled13(1,"#ffffff");
      colorled13(2,"#ffffff");
      TimerFreeTone(8,1500,50);
      delay((Dtime * 12));
      colorled13(1,"#000000");
      colorled13(2,"#000000");
    }
    // 黑.黑.黑
    // 黑、黑、黑
    if (analogRead(A1) > Black && analogRead(A2) > Black && analogRead(A3) > Black) {
    }

}
